## boards/arm/corne_kb/west.yml
```yaml
manifest:
  remotes:
    - name: zmkfirmware
      url-base: https://github.com/zmkfirmware
  projects:
    - name: corne_kb
      url: https://github.com/fpweb-git/zmk-corne.git
      revision: master
    - name: zmk
      remote: zmkfirmware
      revision: main
      import: app/west.yml
  self:
    path: config
```

## boards/arm/eyelash_corne/Kconfig.board
```kconfig
#
# Copyright (c) 2024 The ZMK Contributors
# SPDX-License-Identifier: MIT
#

config BOARD_CORNE_KB_LEFT
    bool "corne_kb left"
    depends on SOC_NRF52840_QIAA

config BOARD_CORNE_KB_RIGHT
    bool "corne_kb right"
    depends on SOC_NRF52840_QIAA
```
